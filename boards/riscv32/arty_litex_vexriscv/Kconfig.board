## boards/riscv32/arty_litex_vexriscv/Kconfig.board
```kconfig
config BOARD_ARTY_LITEX_VEXRISCV
	bool "Digilent Arty dev board with LiteX/VexRiscV CPU"
	depends on SOC_RISCV32_LITEX_VEXRISCV
```

## soc/riscv32/litex-vexriscv/Kconfig.defconfig
```kconfig
if SOC_RISCV32_LITEX_VEXRISCV

config SOC
	string
	default "litex-vexriscv"

config SYS_CLOCK_HW_CYCLES_PER_SEC
	int
	default 100000000

config RISCV_HAS_CPU_IDLE
	bool

config RISCV_HAS_PLIC
	bool

config NUM_IRQS
	int
	default 12

config RISCV_RAM_BASE_ADDR
	hex
	default	0x40000000

config RISCV_RAM_SIZE
	hex
	default 0x10000000

# currently n-selecting, because of UART Tx interrupt related bug
config SERIAL_SUPPORT_INTERRUPT
	bool

endif # SOC_RISCV32_LITEX_VEXRISCV
```
