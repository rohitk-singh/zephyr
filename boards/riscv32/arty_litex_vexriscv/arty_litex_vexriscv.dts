/*
 * Copyright (c) 2018 - 2019 Antmicro <www.antmicro.com>
 *
 * SPDX-License-Identifier: Apache-2.0
 */

/dts-v1/;

#include <riscv32-litex-vexriscv.dtsi>

/ {
	model = "LiteX VexRiscV";
	compatible = "litex,vexriscv";
	chosen {
		zephyr,console = &uart0;
		zephyr,shell-uart = &uart0;
		zephyr,timer = &timer0;
	};
};

&uart0 {
	status = "ok";
	current-speed = <115200>;
};

&timer0 {
	status = "ok";
};
